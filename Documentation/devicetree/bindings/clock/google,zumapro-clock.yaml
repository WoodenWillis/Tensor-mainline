## Documentation/devicetree/bindings/clock/google,zumapro-clock.yaml
```yaml
# SPDX-License-Identifier: (GPL-2.0-only OR BSD-2-Clause)
%YAML 1.2
---
$id: http://devicetree.org/schemas/clock/google,zumapro-clock.yaml#
$schema: http://devicetree.org/meta-schemas/core.yaml#

title: Google Tensor G4 (zumapro) SoC clock controller

maintainers:
  - Will <239688658+WoodenWillis@users.noreply.github.com>

description: |
  The zumapro clock controller is made of several CMU units, each modeled as
  a separate device tree node. The root clock is OSCCLK (24.576 MHz), which
  must be described as a fixed-rate clock. CMU_TOP derives the base clocks
  from PLLs and dividers and feeds the other CMUs.

  Clock identifiers are defined in 'dt-bindings/clock/google,zumapro.h'.

properties:
  compatible:
    enum:
      - google,zumapro-cmu-top
      - google,zumapro-cmu-g3d
      - google,zumapro-cmu-hsi0
      - google,zumapro-cmu-hsi2
      - google,zumapro-cmu-misc
      - google,zumapro-cmu-peric0

  clocks:
    minItems: 1
    maxItems: 7

  clock-names:
    minItems: 1
    maxItems: 7

  "#clock-cells":
    const: 1

  reg:
    maxItems: 1

required:
  - compatible
  - "#clock-cells"
  - clocks
  - clock-names
  - reg

allOf:
  - if:
      properties:
        compatible:
          contains:
            const: google,zumapro-cmu-top
    then:
      properties:
        clocks:
          items:
            - description: External reference clock (24.576 MHz)

        clock-names:
          items:
            - const: oscclk

  - if:
      properties:
        compatible:
          contains:
            const: google,zumapro-cmu-g3d
    then:
      properties:
        clocks:
          items:
            - description: External reference clock (24.576 MHz)
            - description: G3D global clock (from CMU_TOP)
            - description: G3D NOC data clock (from CMU_TOP)
            - description: G3D switch clock (from CMU_TOP)
            - description: G3D trace clock (from CMU_TOP)
            - description: G3D core DVFS clock (from ACPM)
            - description: G3D L2 DVFS clock (from ACPM)

        clock-names:
          items:
            - const: oscclk
            - const: glb
            - const: nocd
            - const: switch
            - const: trace
            - const: g3d
            - const: g3dl2

  - if:
      properties:
        compatible:
          contains:
            const: google,zumapro-cmu-hsi0
    then:
      properties:
        clocks:
          items:
            - description: External reference clock (24.576 MHz)
            - description: HSI0 NOC clock (from CMU_TOP)
            - description: HSI0 peripheral clock (from CMU_TOP)

        clock-names:
          items:
            - const: oscclk
            - const: noc
            - const: peri

  - if:
      properties:
        compatible:
          contains:
            const: google,zumapro-cmu-hsi2
    then:
      properties:
        clocks:
          items:
            - description: External reference clock (24.576 MHz)
            - description: HSI2 NOC clock (from CMU_TOP)
            - description: HSI2 embedded UFS clock (from CMU_TOP)

        clock-names:
          items:
            - const: oscclk
            - const: noc
            - const: ufs_embd

  - if:
      properties:
        compatible:
          contains:
            const: google,zumapro-cmu-misc
    then:
      properties:
        clocks:
          items:
            - description: External reference clock (24.576 MHz)
            - description: MISC NOC clock (from CMU_TOP)

        clock-names:
          items:
            - const: oscclk
            - const: bus

  - if:
      properties:
        compatible:
          contains:
            const: google,zumapro-cmu-peric0
    then:
      properties:
        clocks:
          items:
            - description: External reference clock (24.576 MHz)
            - description: PERIC0 NOC clock (from CMU_TOP)
            - description: PERIC0 IP clock (from CMU_TOP)

        clock-names:
          items:
            - const: oscclk
            - const: noc
            - const: ip

additionalProperties: false

examples:
  - |
    #include <dt-bindings/clock/google,zumapro.h>

    clock-controller@10800000 {
        compatible = "google,zumapro-cmu-peric0";
        reg = <0x10800000 0x8000>;
        #clock-cells = <1>;
        clocks = <&ext_24_5m>,
                 <&cmu_top CLK_DOUT_CMU_PERIC0_NOC>,
                 <&cmu_top CLK_DOUT_CMU_PERIC0_IP>;
        clock-names = "oscclk", "noc", "ip";
    };

...
```

## Documentation/devicetree/bindings/input/touchscreen/synaptics,s3908.yaml
```yaml
# SPDX-License-Identifier: GPL-2.0-only OR BSD-2-Clause
%YAML 1.2
---
$id: http://devicetree.org/schemas/input/touchscreen/synaptics,s3908.yaml#
$schema: http://devicetree.org/meta-schemas/core.yaml#

title: Synaptics TouchComm SPI touchscreen controller

description:
  Synaptics touchscreen controllers that speak the TouchComm protocol
  over SPI, such as the S3908 in the Google Pixel 9 Pro.

maintainers:
  - Will <239688658+WoodenWillis@users.noreply.github.com>

allOf:
  - $ref: touchscreen.yaml#
  - $ref: /schemas/spi/spi-peripheral-props.yaml#

properties:
  compatible:
    const: synaptics,s3908

  reg:
    maxItems: 1

  interrupts:
    maxItems: 1

  reset-gpios:
    maxItems: 1

  vdd-supply:
    description: Digital power supply regulator on the VDD pin

  avdd-supply:
    description: Analog power supply regulator on the AVDD pin

  spi-max-frequency: true
  touchscreen-inverted-x: true
  touchscreen-inverted-y: true
  touchscreen-size-x: true
  touchscreen-size-y: true
  touchscreen-swapped-x-y: true

additionalProperties: false

required:
  - compatible
  - reg
  - interrupts
  - vdd-supply
  - avdd-supply

examples:
  - |
    #include <dt-bindings/interrupt-controller/irq.h>
    #include <dt-bindings/gpio/gpio.h>
    spi {
      #address-cells = <1>;
      #size-cells = <0>;

      touchscreen@0 {
        compatible = "synaptics,s3908";
        reg = <0>;
        interrupt-parent = <&gpn0>;
        interrupts = <0 IRQ_TYPE_LEVEL_LOW>;
        reset-gpios = <&gpp1 1 GPIO_ACTIVE_LOW>;
        vdd-supply = <&ts_dvdd>;
        avdd-supply = <&ts_avdd>;
        spi-max-frequency = <1000000>;
      };
    };

...
```

## Documentation/devicetree/bindings/mfd/samsung,s2mpg14-pmic.yaml
```yaml
# SPDX-License-Identifier: GPL-2.0-only OR BSD-2-Clause
%YAML 1.2
---
$id: http://devicetree.org/schemas/mfd/samsung,s2mpg14-pmic.yaml#
$schema: http://devicetree.org/meta-schemas/core.yaml#

title: Samsung S2MPG14 / S2MPG15 Power Management IC

maintainers:
  - Will <239688658+WoodenWillis@users.noreply.github.com>

description: |
  The Samsung S2MPG14 (main) and S2MPG15 (sub) are the PMIC pair used with
  the Google Tensor G4 (zumapro) SoC. They are accessed through the ACPM
  firmware and are described as children of the ACPM IPC node.

properties:
  compatible:
    enum:
      - samsung,s2mpg14-pmic
      - samsung,s2mpg15-pmic

required:
  - compatible

additionalProperties: false

examples:
  - |
    pmic-1 {
        compatible = "samsung,s2mpg14-pmic";
    };

...
```

## Documentation/devicetree/bindings/power/google,zumapro-gpu-dvfs.yaml
```yaml
# SPDX-License-Identifier: GPL-2.0-only OR BSD-2-Clause
%YAML 1.2
---
$id: http://devicetree.org/schemas/power/google,zumapro-gpu-dvfs.yaml#
$schema: http://devicetree.org/meta-schemas/core.yaml#

title: Google zumapro GPU DVFS performance domain

maintainers:
  - WoodenWillis <239688658+WoodenWillis@users.noreply.github.com>

description:
  Performance domain for the zumapro Mali GPU. The ACPM firmware owns the G3D
  PLLs and rails and scales them per DVFS domain. Each GPU performance level
  sets the top-level (g3dl2) and shader (g3d) ACPM DVFS clocks together.

properties:
  $nodename:
    pattern: '^power-controller(-[a-z0-9]+)?$'

  compatible:
    const: google,zumapro-gpu-dvfs

  clocks:
    items:
      - description: ACPM G3DL2 DVFS clock, feeding the GPU top level and L2
      - description: ACPM G3D DVFS clock, feeding the shader stacks

  clock-names:
    items:
      - const: g3dl2
      - const: g3d

  "#power-domain-cells":
    const: 0

required:
  - compatible
  - clocks
  - clock-names
  - "#power-domain-cells"

additionalProperties: false

examples:
  - |
    #include <dt-bindings/clock/google,zumapro-acpm.h>

    power-controller {
        compatible = "google,zumapro-gpu-dvfs";
        clocks = <&acpm_ipc ZUMAPRO_CLK_ACPM_DVFS_G3DL2>,
                 <&acpm_ipc ZUMAPRO_CLK_ACPM_DVFS_G3D>;
        clock-names = "g3dl2", "g3d";
        #power-domain-cells = <0>;
    };
```

## Documentation/devicetree/bindings/power/supply/maxim,max77779-fg.yaml
```yaml
# SPDX-License-Identifier: GPL-2.0-only OR BSD-2-Clause
%YAML 1.2
---
$id: http://devicetree.org/schemas/power/supply/maxim,max77779-fg.yaml#
$schema: http://devicetree.org/meta-schemas/core.yaml#

title: Maxim MAX77779 fuel gauge

maintainers:
  - Will <239688658+WoodenWillis@users.noreply.github.com>

description:
  ModelGauge m5 fuel gauge block of the Maxim MAX77779 PMIC, on its own
  I2C address.

allOf:
  - $ref: power-supply.yaml#

properties:
  compatible:
    const: maxim,max77779-fg

  reg:
    maxItems: 1

  interrupts:
    maxItems: 1

  shunt-resistor-micro-ohms:
    description: Value of the battery current sense resistor.

required:
  - compatible
  - reg
  - shunt-resistor-micro-ohms

unevaluatedProperties: false

examples:
  - |
    i2c {
      #address-cells = <1>;
      #size-cells = <0>;

      fuel-gauge@36 {
        compatible = "maxim,max77779-fg";
        reg = <0x36>;
        shunt-resistor-micro-ohms = <2000>;
      };
    };
```

## arch/arm64/configs/caiman_defconfig
```kconfig
# CONFIG_LOCALVERSION_AUTO is not set
CONFIG_SYSVIPC=y
CONFIG_POSIX_MQUEUE=y
# CONFIG_CROSS_MEMORY_ATTACH is not set
CONFIG_NO_HZ_IDLE=y
CONFIG_BPF_SYSCALL=y
# CONFIG_CPU_ISOLATION is not set
# CONFIG_SCHED_CACHE is not set
CONFIG_CGROUPS=y
CONFIG_MEMCG=y
CONFIG_CGROUP_PIDS=y
CONFIG_CGROUP_BPF=y
CONFIG_NAMESPACES=y
CONFIG_INITRAMFS_FORCE=y
CONFIG_BOOT_CONFIG=y
CONFIG_CC_OPTIMIZE_FOR_SIZE=y
CONFIG_EXPERT=y
# CONFIG_BUG is not set
# CONFIG_IO_URING is not set
# CONFIG_CACHESTAT_SYSCALL is not set
# CONFIG_KALLSYMS is not set
CONFIG_ARCH_BCM=y
CONFIG_ARCH_EXYNOS=y
# CONFIG_AMPERE_ERRATUM_AC03_CPU_38 is not set
# CONFIG_AMPERE_ERRATUM_AC04_CPU_23 is not set
# CONFIG_ARM64_ERRATUM_826319 is not set
# CONFIG_ARM64_ERRATUM_827319 is not set
# CONFIG_ARM64_ERRATUM_824069 is not set
# CONFIG_ARM64_ERRATUM_819472 is not set
# CONFIG_ARM64_ERRATUM_832075 is not set
# CONFIG_ARM64_ERRATUM_843419 is not set
# CONFIG_ARM64_ERRATUM_1024718 is not set
# CONFIG_ARM64_ERRATUM_1165522 is not set
# CONFIG_ARM64_ERRATUM_1319367 is not set
# CONFIG_ARM64_ERRATUM_1530923 is not set
# CONFIG_ARM64_ERRATUM_1463225 is not set
# CONFIG_ARM64_ERRATUM_1508412 is not set
# CONFIG_ARM64_ERRATUM_2051678 is not set
# CONFIG_ARM64_ERRATUM_2077057 is not set
# CONFIG_ARM64_ERRATUM_2658417 is not set
# CONFIG_ARM64_ERRATUM_2054223 is not set
# CONFIG_ARM64_ERRATUM_2067961 is not set
# CONFIG_ARM64_ERRATUM_2645198 is not set
# CONFIG_ARM64_ERRATUM_2966298 is not set
# CONFIG_ARM64_ERRATUM_3117295 is not set
# CONFIG_ARM64_ERRATUM_3194386 is not set
# CONFIG_ARM64_ERRATUM_4311569 is not set
# CONFIG_ARM64_ERRATUM_4118414 is not set
# CONFIG_CAVIUM_ERRATUM_22375 is not set
# CONFIG_CAVIUM_ERRATUM_23154 is not set
# CONFIG_CAVIUM_ERRATUM_27456 is not set
# CONFIG_CAVIUM_ERRATUM_30115 is not set
# CONFIG_CAVIUM_TX2_ERRATUM_219 is not set
# CONFIG_FUJITSU_ERRATUM_010001 is not set
# CONFIG_HISILICON_ERRATUM_161600802 is not set
# CONFIG_HISILICON_ERRATUM_162100801 is not set
# CONFIG_HISILICON_ERRATUM_162100125 is not set
# CONFIG_QCOM_FALKOR_ERRATUM_1003 is not set
# CONFIG_QCOM_FALKOR_ERRATUM_1009 is not set
# CONFIG_QCOM_QDF2400_ERRATUM_0065 is not set
# CONFIG_QCOM_FALKOR_ERRATUM_E1041 is not set
# CONFIG_NVIDIA_CARMEL_CNP_ERRATUM is not set
# CONFIG_NVIDIA_OLYMPUS_1027_ERRATUM is not set
# CONFIG_RENESAS_ERRATUM_GEN4GICITS1 is not set
# CONFIG_ROCKCHIP_ERRATUM_3568002 is not set
# CONFIG_ROCKCHIP_ERRATUM_3588001 is not set
# CONFIG_SOCIONEXT_SYNQUACER_PREITS is not set
CONFIG_HOTPLUG_CPU=y
# CONFIG_UNMAP_KERNEL_AT_EL0 is not set
# CONFIG_MITIGATE_SPECTRE_BRANCH_HISTORY is not set
# CONFIG_ARM64_TAGGED_ADDR_ABI is not set
# CONFIG_ARM64_HW_AFDBM is not set
# CONFIG_ARM64_RAS_EXTN is not set
# CONFIG_ARM64_CNP is not set
# CONFIG_ARM64_PTR_AUTH is not set
# CONFIG_ARM64_AMU_EXTN is not set
# CONFIG_ARM64_TLB_RANGE is not set
# CONFIG_ARM64_BTI is not set
# CONFIG_ARM64_E0PD is not set
# CONFIG_ARM64_EPAN is not set
# CONFIG_ARM64_POE is not set
# CONFIG_ARM64_GCS is not set
# CONFIG_ARM64_LSUI is not set
# CONFIG_ARM64_SVE is not set
# CONFIG_RELOCATABLE is not set
CONFIG_CMDLINE="earlycon=exynos4210,mmio32,0x10870000 console=tty0 console=ttySAC0,921600n8 fbcon=font:TER16x32 clk_ignore_unused regulator_ignore_unused fw_devlink=permissive ehld.noehld=1 s3c2410_wdt.soft_noboot=1"
CONFIG_CMDLINE_FORCE=y
# CONFIG_EFI is not set
# CONFIG_SUSPEND is not set
CONFIG_PM=y
CONFIG_ENERGY_MODEL=y
CONFIG_CPU_IDLE=y
CONFIG_CPU_IDLE_GOV_LADDER=y
CONFIG_CPU_IDLE_GOV_MENU=y
CONFIG_CPU_IDLE_GOV_TEO=y
CONFIG_ARM_PSCI_CPUIDLE=y
CONFIG_CPU_FREQ=y
CONFIG_CPU_FREQ_STAT=y
CONFIG_CPU_FREQ_GOV_USERSPACE=y
CONFIG_CPUFREQ_DT=y
CONFIG_VIRTUALIZATION=y
CONFIG_KVM=y
# CONFIG_SCHED_SMT is not set
# CONFIG_SCHED_CLUSTER is not set
# CONFIG_SCHED_MC is not set
# CONFIG_STACKPROTECTOR is not set
# CONFIG_RANDOMIZE_KSTACK_OFFSET is not set
# CONFIG_COREDUMP is not set
CONFIG_SLUB_TINY=y
# CONFIG_COMPAT_BRK is not set
# CONFIG_COMPACTION is not set
# CONFIG_ZONE_DMA is not set
# CONFIG_ZONE_DMA32 is not set
# CONFIG_SECRETMEM is not set
CONFIG_NET=y
CONFIG_UNIX=y
CONFIG_INET=y
CONFIG_DEVTMPFS=y
CONFIG_DEVTMPFS_MOUNT=y
# CONFIG_STANDALONE is not set
# CONFIG_PREVENT_FIRMWARE_BUILD is not set
# CONFIG_ALLOW_DEV_COREDUMP is not set
CONFIG_EXYNOS_ACPM_PROTOCOL=y
# CONFIG_ARM_SMCCC_SOC_ID is not set
CONFIG_SCSI=y
CONFIG_BLK_DEV_SD=y
CONFIG_INPUT_EVDEV=y
CONFIG_INPUT_TOUCHSCREEN=y
CONFIG_TOUCHSCREEN_SYNAPTICS_TCM=y
CONFIG_SERIAL_SAMSUNG=y
CONFIG_SERIAL_SAMSUNG_CONSOLE=y
CONFIG_VIRTIO_CONSOLE=y
# CONFIG_HW_RANDOM is not set
# CONFIG_DEVPORT is not set
CONFIG_SPI=y
CONFIG_SPI_S3C64XX=y
# CONFIG_HWMON is not set
CONFIG_WATCHDOG=y
CONFIG_S3C2410_WATCHDOG=y
CONFIG_ZUMA_WDT_DISABLE=y
CONFIG_MFD_SEC_ACPM=y
CONFIG_REGULATOR=y
CONFIG_REGULATOR_FIXED_VOLTAGE=y
CONFIG_REGULATOR_S2MPS11=y
CONFIG_DRM=y
CONFIG_DRM_PANTHOR=y
CONFIG_DRM_ZUMAPRO_DECON=y
CONFIG_FB=y
CONFIG_USB=y
CONFIG_TYPEC=y
CONFIG_TYPEC_UCSI=y
CONFIG_TYPEC_MUX_GPIO_SBU=y
CONFIG_SCSI_UFSHCD=y
CONFIG_SCSI_UFSHCD_PLATFORM=y
CONFIG_SCSI_UFS_EXYNOS=y
CONFIG_RTC_CLASS=y
CONFIG_RTC_DRV_S5M=y
# CONFIG_VIRTIO_MENU is not set
# CONFIG_VHOST_MENU is not set
# CONFIG_SURFACE_PLATFORMS is not set
# CONFIG_ARM64_PLATFORM_DEVICES is not set
CONFIG_EXYNOS_ACPM_CLK=y
# CONFIG_ARM_ARCH_TIMER_EVTSTREAM is not set
# CONFIG_FSL_ERRATUM_A008585 is not set
# CONFIG_HISILICON_ERRATUM_161010101 is not set
# CONFIG_ARM64_ERRATUM_858921 is not set
CONFIG_MAILBOX=y
CONFIG_EXYNOS_MBOX=y
CONFIG_ZUMAPRO_GPU_DVFS=y
CONFIG_DEVFREQ_GOV_USERSPACE=y
CONFIG_PHY_SAMSUNG_UFS=y
CONFIG_EXT4_FS=y
CONFIG_EXT4_FS_POSIX_ACL=y
CONFIG_F2FS_FS=y
# CONFIG_DNOTIFY is not set
CONFIG_AUTOFS_FS=y
CONFIG_TMPFS=y
CONFIG_TMPFS_POSIX_ACL=y
# CONFIG_MISC_FILESYSTEMS is not set
# CONFIG_CRC_OPTIMIZATIONS is not set
CONFIG_FONTS=y
CONFIG_FONT_8x16=y
CONFIG_FONT_TER16x32=y
CONFIG_DYNAMIC_DEBUG=y
# CONFIG_SYMBOLIC_ERRNAME is not set
# CONFIG_DEBUG_MISC is not set
# CONFIG_SECTION_MISMATCH_WARN_ONLY is not set
CONFIG_DEBUG_FS=y
# CONFIG_RCU_TRACE is not set
# CONFIG_FTRACE is not set
# CONFIG_RUNTIME_TESTING_MENU is not set
```
